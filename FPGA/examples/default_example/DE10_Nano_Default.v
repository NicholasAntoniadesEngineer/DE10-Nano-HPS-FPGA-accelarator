//=======================================================
//  This code is generated by Terasic System Builder
//  This is the top-level module for the DE10-Nano FPGA board
//=======================================================

module DE10_Nano_Default(
    // Port declarations are grouped by functionality
    
    //////////// ADC (Analog-to-Digital Converter) Interface //////////
    output          		ADC_CONVST,    // ADC Convert Start signal
    output          		ADC_SCK,       // ADC Serial Clock
    output          		ADC_SDI,       // ADC Serial Data Input
    input           		ADC_SDO,       // ADC Serial Data Output

    //////////// Arduino Header Interface //////////
    inout     [15:0]		ARDUINO_IO,     // 16 GPIO pins for Arduino compatibility
    inout           		ARDUINO_RESET_N,// Arduino reset signal

    //////////// Clock Inputs //////////
    input           		FPGA_CLK1_50,  // 50MHz clock input 1
    input           		FPGA_CLK2_50,  // 50MHz clock input 2
    input           		FPGA_CLK3_50,  // 50MHz clock input 3

    //////////// Push Buttons //////////
    input      [1:0]		KEY,           // Two push buttons

    //////////// LED Outputs //////////
    output     [7:0]		LED,           // 8 LEDs

    //////////// Slide Switches //////////
    input      [3:0]		SW             // 4 slide switches
);

//=======================================================
//  Internal Signals Declaration
//=======================================================
reg [23:0] clk_divider;   // Counter for clock division
wire slow_clk;            // Divided clock signal for LED blinking

reg [7:0] Cont;          // 8-bit counter for LED pattern

// HDMI color signal declarations
wire [7:0] hdmi_b;       // Blue color channel
wire [7:0] hdmi_g;       // Green color channel
wire [7:0] hdmi_r;       // Red color channel
wire       disp_clk;     // Display clock
wire       disp_de;      // Display enable
wire       disp_hs;      // Horizontal sync
wire       disp_vs;      // Vertical sync
wire       DLY_RST;      // Delayed reset signal

//=======================================================
//  Implementation
//=======================================================
// Set GPIO pins to high impedance (unused in this design)
assign GPIO_0 = 36'hzzzzzzzz;
assign GPIO_1 = 36'hzzzzzzzz;

// Clock divider process for LED blinking
always @(posedge FPGA_CLK1_50 or negedge KEY[0]) begin
    if (!KEY[0])         // If reset button pressed
        clk_divider <= 0;
    else                 // Increment counter on each clock
        clk_divider <= clk_divider + 1;
end

// Create slower clock by selecting bit 18 of the divider
// This creates a clock divider by taking bit 18 of the counter:
// - Input clock is 50MHz (period = 20ns)
// - Bit 18 changes state every 2^18 cycles
// - So one full period takes 2^19 cycles
// - Period = 2^19 * 20ns = 10.49ms
// - Therefore frequency = 1/10.49ms ≈ 190Hz
assign slow_clk = clk_divider[18]; // Creates roughly 190Hz clock from 50MHz

// Counter process for LED pattern
always @(posedge slow_clk or negedge KEY[0]) begin
    if (!KEY[0])         // Reset counter when button pressed
         Cont <= 0;
    else                 // Increment counter on slow clock
         Cont <= Cont + 1;
end

// LED output control - shows counter value or all ON when reset
assign LED = KEY[0] ? Cont : 8'hff;

// Reset delay module instantiation
Reset_Delay	r0	(	
    .iCLK(FPGA_CLK1_50),
    .oRESET(DLY_RST)
);
// PLL for clock generation
sys_pll u_sys_pll (
   .refclk(FPGA_CLK1_50),    // Input 50MHz clock
   .rst(1'b0),               // No reset
   .outclk_0(pll_1536k),     // Output clock for audio
endmodule
